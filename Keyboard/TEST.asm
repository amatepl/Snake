;
; Keyboard.asm
;
; Created: 2019-03-19 08:52:37
; Author : Mateusz
;
.INCLUDE "m328pdef.inc"
.ORG 0x0000 
CLR R16
CLR R17
CLR R18
CLR R19
CLC

LDI R16,0b00000000
OUT PORTB,R16
CBI DDRB,3			; Clearing the outputs
CBI DDRB,4
CBI DDRB,5

INIT:
	LDI R16,80	; COUNTERS
	LDI R18,8
	;LDI R20,8
	LDI R17,0b001	; Setting first column to 1
	LDI R19,0b11000001
	

COLUMNS:
	ROL R17
	BRCC NOPB3
	SBI DDRB,3
	NOP
	SBI PORTB,3
	SBI DDRB,5
	NOP
	SBI PORTB,5
	CBI DDRB,5
	NOP
	CBI PORTB,5
	CBI DDRB,3
	NOP
	CBI PORTB,3
	JMP JUMP
NOPB3:
	
	SBI DDRB,5
	NOP
	SBI PORTB,5
	CBI DDRB,5
	NOP
	CBI PORTB,5
JUMP:
	DEC R16
	CPI R16,0
	BRNE COLUMNS

ROWS:
	ROL R19
	BRCC NOONE
	SBI DDRB,3
	NOP
	SBI PORTB,3
	SBI DDRB,5
	NOP
	SBI PORTB,5
	CBI DDRB,5
	NOP
	CBI PORTB,5
	CBI DDRB,3
	NOP
	CBI PORTB,3
	JMP JUMP2
NOONE:
	
	SBI DDRB,5
	NOP
	SBI PORTB,5
	CBI DDRB,5
	NOP
	CBI PORTB,5
JUMP2:
	DEC R18
	CPI R18,0
	BRNE ROWS


SBI DDRB,4
CBI DDRB,4

JMP INIT



